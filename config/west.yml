## config/west.yml
```yaml
manifest:
  remotes:
    - name: zmkfirmware
      url-base: https://github.com/zmkfirmware
    - name: urob
      url-base: https://github.com/urob
    - name: m165437
      url-base: https://github.com/M165437

  projects:
    # My keyboard layout
    - name: eyelash_corne
      url: https://github.com/zundr/zmk-new_corne
      revision: main

    # ZMK firmware upstream
    - name: zmk
      remote: zmkfirmware
      revision: main
      import: app/west.yml

    # Modules
    - name: zmk-helpers
      remote: urob
      revision: v0.1
      path: modules/zmk/helpers
    - name: zmk-leader-key
      remote: urob
      revision: v0.1+locality
      path: modules/zmk/leader-key

    # Myrioku
    - name: miryoku
      url: https://github.com/zundr/miryoku_zmk
      revision: master
      path: modules/miryoku

    # Nice view gem animation
    - name: nice-view-gem
      path: modules/nice-view-gem
      remote: m165437
      revision: main

  self:
    path: config
```
